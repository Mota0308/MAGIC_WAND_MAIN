## esp32s3/sdkconfig.defaults
```kconfig
# ESP32-S3 N16R8: 8MB Flash, 8MB PSRAM
CONFIG_IDF_TARGET="esp32s3"

# PSRAM (N16R8 has 8MB PSRAM)
CONFIG_SPIRAM=y
CONFIG_SPIRAM_MODE_OCT=y
CONFIG_SPIRAM_SPEED_80M=y
CONFIG_SPIRAM_BOOT_INIT=y
CONFIG_SPIRAM_IGNORE_NOTFOUND=n
CONFIG_SPIRAM_USE_MALLOC=y
CONFIG_SPIRAM_MALLOC_ALWAYSINTERNAL=16384
CONFIG_SPIRAM_MALLOC_RESERVE_INTERNAL=32768

# Increase main task stack for TFLite inference
CONFIG_ESP_MAIN_TASK_STACK_SIZE=8192

# Flash size 8MB (N16R8)
CONFIG_ESPTOOLPY_FLASHSIZE_8MB=y

# C++ support for TFLite Micro
CONFIG_COMPILER_CXX_EXCEPTIONS=n
```
